## boards/shields/triple/Kconfig.defconfig
```kconfig
if SHIELD_TRIPLE_CENTER

config ZMK_KEYBOARD_NAME
    default "3ple"

config ZMK_SPLIT_ROLE_CENTRAL
    default y

config ZMK_SPLIT_BLE_CENTRAL_PERIPHERALS
        default 2

config BT_MAX_CONN
        default 7
config BT_MAX_PAIRED
        default 7

config ZMK_USB
    default y

endif

if SHIELD_TRIPLE_LEFT || SHIELD_TRIPLE_RIGHT || SHIELD_TRIPLE_CENTER

config ZMK_SPLIT
    default y

config ZMK_SPLIT_BLE
    default y

endif
```

## boards/shields/triple/Kconfig.shield
```kconfig
# Copyright (c) 2020 Pete Johanson
# SPDX-License-Identifier: MIT

config SHIELD_TRIPLE_LEFT
    def_bool $(shields_list_contains,triple_left)

config SHIELD_TRIPLE_RIGHT
    def_bool $(shields_list_contains,triple_right)

config SHIELD_TRIPLE_CENTER
    def_bool $(shields_list_contains,triple_center)
```

## config/west.yml
```yaml
manifest:
  remotes:
    - name: zmkfirmware
      url-base: https://github.com/zmkfirmware
    - name: badjeff
      url-base: https://github.com/badjeff
    - name: cyboard
      url-base: https://github.com/Cyboard-DigitalTailor
    - name: b16b00b5
      url-base: https://github.com/b16b00b5

    # Additional modules containing boards/shields/custom code can be listed here as well
    # See https://docs.zephyrproject.org/3.2.0/develop/west/manifest.html#projects
  projects:
    - name: zmk
      remote: zmkfirmware
      revision: main
      import: app/west.yml
    - name: zmk-pmw3610-driver
      remote: b16b00b5
      revision: pmw3360
      # revision: main
  self:
    path: config
```
